## config/west.yml
```yaml
manifest:
  remotes:
    - name: zmkfirmware
      url-base: https://github.com/zmkfirmware
    - name: edysantosa
      url-base: https://github.com/edysantosa
  projects:
    - name: zmk
      remote: edysantosa
      revision: core/zephyr-v3
      import: app/west.yml
  self:
    path: config
```
